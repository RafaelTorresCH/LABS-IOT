## LAB_07/Nivel_Agua/sdkconfig.defaults
```kconfig
#
# Flash / serial console
#
CONFIG_ESPTOOLPY_FLASHSIZE_4MB=y
CONFIG_ESPTOOLPY_FLASHSIZE="4MB"
CONFIG_ESP_CONSOLE_USB_SERIAL_JTAG=y
CONFIG_ESP_CONSOLE_SECONDARY_NONE=y
# end of Flash / serial console

#
# Partition Table
#
CONFIG_PARTITION_TABLE_CUSTOM=y
CONFIG_PARTITION_TABLE_CUSTOM_FILENAME="partitions.csv"
CONFIG_PARTITION_TABLE_FILENAME="partitions.csv"
CONFIG_PARTITION_TABLE_OFFSET=0x8000
CONFIG_PARTITION_TABLE_MD5=y
# end of Partition Table

#
# mbedTLS
#
CONFIG_MBEDTLS_CMAC_C=y
CONFIG_MBEDTLS_SSL_PROTO_DTLS=y
CONFIG_MBEDTLS_KEY_EXCHANGE_ECJPAKE=y
CONFIG_MBEDTLS_ECJPAKE_C=y
# end of mbedTLS

#
# OpenThread
#
CONFIG_OPENTHREAD_ENABLED=y
CONFIG_OPENTHREAD_FTD=n
CONFIG_OPENTHREAD_MTD=y
CONFIG_OPENTHREAD_BORDER_ROUTER=n
CONFIG_OPENTHREAD_DNS64_CLIENT=y
CONFIG_OPENTHREAD_CLI=n
CONFIG_OPENTHREAD_CLI_ESP_EXTENSION=n
CONFIG_OPENTHREAD_NETWORK_AUTO_START=y
CONFIG_OPENTHREAD_RX_ON_WHEN_IDLE=y
CONFIG_OPENTHREAD_NETWORK_NAME="SoilSenseLab"
CONFIG_OPENTHREAD_MESH_LOCAL_PREFIX="fd11:22:33:44::/64"
CONFIG_OPENTHREAD_NETWORK_CHANNEL=15
CONFIG_OPENTHREAD_NETWORK_PANID=0x1234
CONFIG_OPENTHREAD_NETWORK_EXTPANID="dead00beef00cafe"
CONFIG_OPENTHREAD_NETWORK_MASTERKEY="00112233445566778899aabbccddeeff"
CONFIG_OPENTHREAD_STATE_INDICATOR_ENABLE=n
CONFIG_OPENTHREAD_TASK_SIZE=10240
CONFIG_OPENTHREAD_CONSOLE_ENABLE=n
# end of OpenThread

#
# lwIP
#
CONFIG_LWIP_TCPIP_TASK_STACK_SIZE=4096
CONFIG_LWIP_IPV6_NUM_ADDRESSES=8
CONFIG_LWIP_MULTICAST_PING=y
CONFIG_LWIP_HOOK_IP6_SELECT_SRC_ADDR_CUSTOM=y
# end of lwIP

#
# ESP System Settings
#
CONFIG_ESP_MAIN_TASK_STACK_SIZE=6144
# end of ESP System Settings
```

## LAB_07/ftd_battery/main/Kconfig.projbuild
```kconfig
menu "SoilSense FTD Battery Node"

    config SOILSENSE_BATT_ADC_IO
        int "GPIO used by the battery divider"
        default 4
        range 0 48
        help
            Physical GPIO wired to the divider midpoint.

    config SOILSENSE_BATT_DIVIDER_R1_OHM
        int "Upper divider resistor (ohm)"
        default 82500
        range 1 10000000

    config SOILSENSE_BATT_DIVIDER_R2_OHM
        int "Lower divider resistor (ohm)"
        default 82500
        range 1 10000000

    config SOILSENSE_BATT_REPORT_PERIOD_S
        int "Health report period in seconds"
        default 30
        range 5 3600

endmenu
```

## LAB_07/ftd_battery/sdkconfig.defaults
```kconfig
CONFIG_PARTITION_TABLE_CUSTOM=y
CONFIG_PARTITION_TABLE_CUSTOM_FILENAME="partitions.csv"
CONFIG_PARTITION_TABLE_FILENAME="partitions.csv"
CONFIG_PARTITION_TABLE_OFFSET=0x8000
CONFIG_PARTITION_TABLE_MD5=y

CONFIG_ESP_COEX_SW_COEXIST_ENABLE=n

CONFIG_OPENTHREAD_ENABLED=y
CONFIG_OPENTHREAD_DIAG=n
CONFIG_OPENTHREAD_COMMISSIONER=n
CONFIG_OPENTHREAD_JOINER=n
CONFIG_OPENTHREAD_FTD=n
CONFIG_OPENTHREAD_MTD=y
CONFIG_OPENTHREAD_BORDER_ROUTER=n
CONFIG_OPENTHREAD_CLI=n
CONFIG_OPENTHREAD_SRP_CLIENT=n
CONFIG_OPENTHREAD_DNS_CLIENT=n
CONFIG_OPENTHREAD_TASK_SIZE=4096
CONFIG_OPENTHREAD_CONSOLE_ENABLE=n
CONFIG_OPENTHREAD_RX_ON_WHEN_IDLE=y
CONFIG_OPENTHREAD_BORDER_AGENT_ENABLE=n
CONFIG_OPENTHREAD_RCP_SPINEL_CONSOLE=n
CONFIG_OPENTHREAD_NETWORK_NAME="SoilSenseLab"
CONFIG_OPENTHREAD_MESH_LOCAL_PREFIX="fd11:22:33:44::/64"
CONFIG_OPENTHREAD_NETWORK_CHANNEL=15
CONFIG_OPENTHREAD_NETWORK_PANID=0x1234
CONFIG_OPENTHREAD_NETWORK_EXTPANID="dead00beef00cafe"
CONFIG_OPENTHREAD_NETWORK_MASTERKEY="00112233445566778899aabbccddeeff"

CONFIG_COMPILER_OPTIMIZATION_SIZE=y
CONFIG_COMPILER_OPTIMIZATION_ASSERTIONS_SILENT=y
CONFIG_COMPILER_OPTIMIZATION_CHECKS_SILENT=y
CONFIG_COMPILER_SAVE_RESTORE_LIBCALLS=y
CONFIG_ESP_ERR_TO_NAME_LOOKUP=n
CONFIG_ESP_SYSTEM_PANIC_SILENT_REBOOT=y
CONFIG_LOG_DEFAULT_LEVEL_INFO=y
CONFIG_LIBC_NEWLIB_NANO_FORMAT=y
CONFIG_OPENTHREAD_LOG_LEVEL_DYNAMIC=n
CONFIG_OPENTHREAD_LOG_LEVEL_INFO=y
CONFIG_OPENTHREAD_TIMING_OPTIMIZATION=y
CONFIG_FREERTOS_HZ=1000

CONFIG_SOILSENSE_BATT_ADC_IO=4
CONFIG_SOILSENSE_BATT_DIVIDER_R1_OHM=82500
CONFIG_SOILSENSE_BATT_DIVIDER_R2_OHM=82500
CONFIG_SOILSENSE_BATT_REPORT_PERIOD_S=30
```

## LAB_07/sample_project-main/sdkconfig.defaults
```kconfig
# 1. Tabla de Particiones Personalizada
CONFIG_PARTITION_TABLE_CUSTOM=y
CONFIG_PARTITION_TABLE_CUSTOM_FILENAME="partitions.csv"
CONFIG_PARTITION_TABLE_FILENAME="partitions.csv"

# 2. Soporte para WebSockets
CONFIG_HTTPD_WS_SUPPORT=y

# 3. Seguridad mbedTLS y Cookies para CoAP (Nombres para v6.0)
CONFIG_MBEDTLS_SSL_DTLS_SRV=y
CONFIG_MBEDTLS_SSL_COOKIE_C=y
```

## LAB_07/sdkconfig.defaults
```kconfig
#
# Partition Table
#
CONFIG_PARTITION_TABLE_CUSTOM=y
CONFIG_PARTITION_TABLE_CUSTOM_FILENAME="partitions.csv"
CONFIG_PARTITION_TABLE_FILENAME="partitions.csv"
CONFIG_PARTITION_TABLE_OFFSET=0x8000
CONFIG_PARTITION_TABLE_MD5=y
# end of Partition Table

#
# mbedTLS
#
CONFIG_MBEDTLS_CMAC_C=y
CONFIG_MBEDTLS_SSL_PROTO_DTLS=y
CONFIG_MBEDTLS_KEY_EXCHANGE_ECJPAKE=y
CONFIG_MBEDTLS_ECJPAKE_C=y
# end of mbedTLS

#
# OpenThread
#
CONFIG_OPENTHREAD_ENABLED=y
CONFIG_OPENTHREAD_RADIO=y
CONFIG_OPENTHREAD_CLI=n
CONFIG_OPENTHREAD_BORDER_ROUTER=n
CONFIG_OPENTHREAD_SRP_CLIENT=n
CONFIG_OPENTHREAD_DNS_CLIENT=n
CONFIG_OPENTHREAD_DNS64_CLIENT=n
CONFIG_OPENTHREAD_DIAG=n
CONFIG_OPENTHREAD_TASK_SIZE=3072
CONFIG_OPENTHREAD_CONSOLE_ENABLE=n
CONFIG_OPENTHREAD_RCP_USB_SERIAL_JTAG=y
CONFIG_OPENTHREAD_RCP_SPINEL_CONSOLE=y
CONFIG_OPENTHREAD_LOG_LEVEL_DYNAMIC=n
CONFIG_OPENTHREAD_LOG_LEVEL_NONE=y
CONFIG_OPENTHREAD_TIMING_OPTIMIZATION=y
# end of OpenThread

#
# lwIP
#
CONFIG_LWIP_TCPIP_TASK_STACK_SIZE=4096
CONFIG_LWIP_IPV6_NUM_ADDRESSES=8
CONFIG_LWIP_MULTICAST_PING=y
CONFIG_LWIP_HOOK_IP6_SELECT_SRC_ADDR_CUSTOM=y
# end of lwIP

#
# ESP System Settings
#
CONFIG_ESP_MAIN_TASK_STACK_SIZE=6144
# end of ESP System Settings
```
